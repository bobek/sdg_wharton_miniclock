## fw/main/Kconfig.projbuild
```kconfig
menu "Small Clock Configuration"

    config ESP_WIFI_SSID
        string "WiFi SSID"
        default "myssid"
        help
            SSID (network name) for the example to connect to.

    config ESP_WIFI_PASSWORD
        string "WiFi Password"
        default "mypassword"
        help
            WiFi password (WPA or WPA2) for the example to use.

    config ESP_MAXIMUM_RETRY
        int "Maximum retry"
        default 5
        help
            Set the Maximum retry to avoid station reconnecting to the AP unlimited when the AP is really unreachable.

    config SNTP_SERVER_NAME
        string "NTP Server"
        default "pool.ntp.org"
        help
            NTP server to use for time synchronization. Suggest using your private one.

    config LOCAL_TZ_DATA
        string "tzdata timezone definition string"
        default "GMT0BST,M3.5.0/1,M10.5.0"
        help
            tzdata configuration of your timezone, for example Europe/Prague is CET-1CEST,M3.5.0,M10.5.0/3
endmenu
```
